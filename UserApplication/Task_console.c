/*
 * Task_console.c
 *
 *  Created on: 2019. 6. 14.
 *      Author: mjlee2
 */

/* Include */
#include "main.h"
#include "cmsis_os_ext.h"

#include <stdio.h>
#include <string.h>
#include <memory.h>
#include "FreeRTOS_CLI.h"

#include "UserPlatform.h"


/* Macro */
#define cmdMAX_INPUT_SIZE   512
#define cmdMAX_OUTPUT_SIZE  512
#define CONSOLE_TIMEOUT   	1000
#define CONSOLE_PRINT(buf)		printf("%s",buf) // HAL_UART_Transmit(huart, (uint8_t *)buf, strlen((char *)buf), 1000)
#define CONSOLE_PRINT_CHAR(ch)	printf("%c",ch) //HAL_UART_Transmit(huart, (uint8_t *)&ch, 1, 1000)

/* Extern Variable */
extern osMessageQId console_Rx_queueHandle;

/* Internal Variable */
static char cmd_guide[] = "STM32:/$ ";
static char crln[] = "\r\n";
static char cInputString[ cmdMAX_INPUT_SIZE ], cOutputString[ cmdMAX_OUTPUT_SIZE ];
static UART_HandleTypeDef *huart = &USER_CONSOLE_UART_HANDLE;
/* Function */
extern void vRegisterCLICommands();


void StartConsoleTask(void const * argument)
{
	int8_t cInChar, cInputIndex = 0;
	BaseType_t xMoreDataToFollow;

	vRegisterCLICommands();

	CONSOLE_PRINT(cmd_guide);

	/* Infinite loop */
	for(;;)
	{
#if 0 // Polling Method
		/* Non-Blocking Read */
		HAL_StatusTypeDef status = HAL_OK;
		status = HAL_UART_Receive(huart, (uint8_t *)&cInChar, 1, 0);
		if(status != HAL_OK){
			osDelay(1);
			//osThreadYield();
			continue;
		}
#else // Queue Used
		/* Blocking Read */
		osEvent evt = osMessageGet(console_Rx_queueHandle, CONSOLE_TIMEOUT);
		if(evt.status == osEventMessage){
			cInChar = evt.value.v;
		} else {
			continue;
		}
#endif

		/* Iterator */
		{
			switch (cInChar){

			/* New line */
			case '\n' :
			case '\r' :
			{
				CONSOLE_PRINT(crln);
				do {
					/* Pass the string to FreeRTOS+CLI. */
					xMoreDataToFollow = FreeRTOS_CLIProcessCommand( cInputString, cOutputString, cmdMAX_OUTPUT_SIZE );
					CONSOLE_PRINT(cOutputString);

				} while( xMoreDataToFollow != pdFALSE );
				/* All the strings generated by the command processing
				have been sent.  Clear the input string ready to receive
				the next command. */
				cInputIndex = 0;
				memset( cInputString, 0x00, cmdMAX_INPUT_SIZE );
				memset( cOutputString, 0x00, cmdMAX_OUTPUT_SIZE );
				CONSOLE_PRINT(crln);
				CONSOLE_PRINT(cmd_guide);
			}
			break;

			/* Back Space */
			case '\b' :
			case 0x7f : // [DEL]
			{
				if( cInputIndex > 0 )
				{
					cInputIndex--;
					cInputString[ cInputIndex ] = '\0';
					CONSOLE_PRINT_CHAR(cInChar);
				}
			}
			break;

			/* Normal Character */
			default :
			{
				if( cInputIndex < cmdMAX_INPUT_SIZE )
				{
					cInputString[ cInputIndex ] = cInChar;
					cInputIndex++;
					CONSOLE_PRINT_CHAR(cInChar);
				}
			}
			break;
			}
		}
		osThreadYield();
	}
	osThreadYield();
}
